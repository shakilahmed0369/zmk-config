## boards/shields/lily58/Kconfig
```kconfig
# Lily58 split keyboard — shield Kconfig
#
# Declares the SHIELD_LILY58_LEFT / SHIELD_LILY58_RIGHT bool symbols so they
# are visible to if-guards in Kconfig.defconfig and the rest of the build.

config SHIELD_LILY58_LEFT
	def_bool $(shields_list_contains,lily58_left)

config SHIELD_LILY58_RIGHT
	def_bool $(shields_list_contains,lily58_right)
```

## boards/shields/lily58/Kconfig.defconfig
```kconfig
# Lily58 split keyboard — default configuration values
#
# Only set defaults for symbols that ZMK already declares with a type.
# BT profiles, USB, sleep timeout etc. belong in config/lily58.conf.

if SHIELD_LILY58_LEFT || SHIELD_LILY58_RIGHT

config ZMK_KEYBOARD_NAME
	default "Lily58"

config ZMK_SPLIT
	default y

endif # SHIELD_LILY58_LEFT || SHIELD_LILY58_RIGHT

if SHIELD_LILY58_LEFT

config ZMK_SPLIT_ROLE_CENTRAL
	default y

endif # SHIELD_LILY58_LEFT
```

## boards/shields/lily58_hw/Kconfig.defconfig
```kconfig
# Lily58 HW (hand-wired) split keyboard — default configuration values
#
# Only set defaults for symbols that ZMK already declares with a type.
# BT profiles, USB, sleep timeout etc. belong in config/lily58_hw.conf.

if SHIELD_LILY58_HW_LEFT || SHIELD_LILY58_HW_RIGHT

config ZMK_KEYBOARD_NAME
	default "Lily58 HW"

config ZMK_SPLIT
	default y

endif # SHIELD_LILY58_HW_LEFT || SHIELD_LILY58_HW_RIGHT

if SHIELD_LILY58_HW_LEFT

config ZMK_SPLIT_ROLE_CENTRAL
	default y

endif # SHIELD_LILY58_HW_LEFT

if SHIELD_LILY58_HW_LEFT || SHIELD_LILY58_HW_RIGHT

config ZMK_DISPLAY
	select SSD1306
	select I2C

endif # SHIELD_LILY58_HW_LEFT || SHIELD_LILY58_HW_RIGHT
```

## boards/shields/lily58_hw/Kconfig.shield
```kconfig
# Lily58 HW (hand-wired) split keyboard — shield Kconfig
#
# Declares the SHIELD_LILY58_HW_LEFT / SHIELD_LILY58_HW_RIGHT bool symbols so they
# are visible to if-guards in Kconfig.defconfig and the rest of the build.

config SHIELD_LILY58_HW_LEFT
	def_bool $(shields_list_contains,lily58_hw_left)

config SHIELD_LILY58_HW_RIGHT
	def_bool $(shields_list_contains,lily58_hw_right)
```
